## conf/local.conf
```bitbake
# CONF_VERSION is increased each time build/conf/ changes incompatibly
CONF_VERSION = "2"

# Which files do we want to parse:
BBMASK = ""

# Don't generate the mirror tarball for SCM repos, the snapshot is enough
BB_GENERATE_MIRROR_TARBALLS = "0"

# Disable build time patch resolution. This would launch a devshell
# and wait for manual intervention. We disable it.
PATCHRESOLVE = "noop"


#
# ========================================================================
# Parallelism Options
# ========================================================================
#
# These options control how much parallelism BitBake should use. The first
# option determines how many tasks bitbake should run in parallel:
# Default to setting automatically based on cpu count
# BB_NUMBER_THREADS ?= "${@oe.utils.cpu_count()}"
BB_NUMBER_THREADS = "20"

# The second option controls how many processes make should run in parallel
# when running parsing tasks:
# Default to setting automatically based on cpu count
BB_NUMBER_PARSE_THREADS ?= "${@oe.utils.cpu_count()}"
# BB_NUMBER_PARSE_THREADS = "22"

# The second option controls how many processes make should run in parallel
# when running compile tasks:
# Default to setting automatically based on cpu count
# PARALLEL_MAKE ?= "-j ${@oe.utils.cpu_count()}"
PARALLEL_MAKE = "-j 20"

# The next option controls how many processes should run in parallel
# when running fetch tasks:
# Default to setting automatically based on cpu count
# do_fetch[number_threads] = "${@oe.utils.cpu_count()}"
do_fetch[number_threads] = "2"


#
# ========================================================================
# Shared-state files from other locations
# ========================================================================
#
# Shared state files are prebuilt cache data objects which can
# used to accelerate build time. This variable can be used to configure the
# system to search other mirror locations for these objects before it builds
# the data itself.
#
# This can be a filesystem directory, or a remote url such as http or ftp.
# These would contain the sstate-cache results from previous builds (possibly
# from other machines). This variable works like fetcher MIRRORS/PREMIRRORS
# and points to the cache locations to check for the shared objects.
#SSTATE_MIRRORS ?= "\
#file://.* https://storage.googleapis.com/lmp-cache/sstate-cache/PATH \n \
#"

# enable PR service on build machine itself
# its good for a case when this is the only builder
# generating the feeds
#PRSERV_HOST = "localhost:0"

#
# Default kernel provider
#
# The default kernel provider in the Linux microPlatform is 'linux-lmp', but
# if you wish to use the kernel provided by the board BSP layer, or your own
# kernel, replace the line below with the recipe name used by the desired
# kernel provider.
PREFERRED_PROVIDER_virtual/kernel ?= "linux-lmp"

# By default LmP kernel is configured to load only signed modules.
# The default key provided should only be used for development purposes.
# To create a custom signing key, follow the instructions on kernel documentation.
MODSIGN_KEY_DIR ?= "${TOPDIR}/conf/keys"

#
# SPL / U-Boot proper signing support
#
# Supported key type: RSA 2048
UBOOT_SPL_SIGN_KEYNAME ?= "spldev"
#
# U-Boot / fitImage signing support
#
# Supported key type: RSA 2048
UBOOT_SIGN_KEYDIR ??= "${TOPDIR}/conf/keys"
UBOOT_SIGN_KEYNAME ?= "ubootdev"
#UBOOT_SIGN_ENABLE ?= "1"

#
# OP-TEE: Custom TA signing key
#
# By default OP-TEE uses a development tree available as part of the git
# repository, which should only be used for development purposes. To use a
# custom signing key just generate a custom RSA 2048 key (PEM format) and
# set via the OPTEE_TA_SIGN_KEY variable.
OPTEE_TA_SIGN_KEY ??= "${TOPDIR}/conf/keys/opteedev.key"

#
# UEFI Secure Boot
#
# Folder for UEFI keys and certificates
UEFI_SIGN_KEYDIR ??= "${TOPDIR}/conf/keys/uefi"
#UEFI_SIGN_ENABLE ?= "1"

#
# Fix Code Aurora mirrors
#
# Revert v90
MIRRORS += " \
    git://source.codeaurora.org/external/imx/ git://github.com/nxp-imx/ \n \
    https://source.codeaurora.org/external/imx/ https://github.com/nxp-imx/ \n \
    http://source.codeaurora.org/external/imx/ http://github.com/nxp-imx/ \n \
    gitsm://source.codeaurora.org/external/imx/ gitsm://github.com/nxp-imx/ \n \
"

# Automatically accept EULA
ACCEPT_FSL_EULA = "1"


#
# ========================================================================
# Packages and Features Management
# ========================================================================
#
# These options control the features and packages to be add to the image.
# Use them to customize the final image. The first option specifies the
# package manager the OpenEmbedded build system uses when packaging data.
# Defaults to None.
# PACKAGE_CLASSES ?= "package_deb"

# The second option sets the list of additional features to include in
# an image. Defaults to None. Here are some examples of features you can add: 
# 
# "dbg-pkgs" - Adds -dbg packages for all installed packages
#              including symbol information for debugging and
#              profiling.

# "debug-tweaks" - Makes an image suitable for development.
#                  For example, ssh root access has a blank
#                  password.  You should remove this feature
#                  before you produce a production image.

# "dev-pkgs" - Adds -dev packages for all installed packages.
#              This is useful if you want to develop against
#              the libraries in the image.

# "read-only-rootfs" - Creates an image whose root
#                      filesystem is read-only. See the
#                      "Creating a Read-Only Root Filesystem"
#                      section in the Yocto Project
#                      Development Manual for more
#                      information

# "tools-debug" - Adds debugging tools such as gdb and
#                 strace.

# "tools-profile" - Adds profiling tools such as oprofile,
#                   exmap, lttng and valgrind (x86 only).

# "tools-sdk" - Adds development tools such as gcc, make,
#               pkgconfig and so forth.

# "tools-testapps" - Adds useful testing tools such as
#                    ts_print, aplay, arecord and so
#                    forth.
EXTRA_IMAGE_FEATURES = "package-management"

# The last option specifies the packages to install into an image.
# Defaults to None.
IMAGE_INSTALL += "apt c-ares ca-certificates curl gnutls krb5 libidn libssh2 mbedtls nano"
IMAGE_INSTALL += "nghttp2 openldap openssh openssl p7zip perl unzip wolfssl xz zlib zstd"
```
